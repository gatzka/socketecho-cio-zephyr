## CMakeLists.txt
```
# SPDX-License-Identifier: Apache-2.0

cmake_minimum_required(VERSION 3.13.1)
set(CIO_BUILD_FOR_ZEPHYR ON)

include($ENV{ZEPHYR_BASE}/cmake/app/boilerplate.cmake NO_POLICY_SCOPE)
project(socket_echo_cio)

target_sources(app PRIVATE src/socket_echo.c)
target_link_libraries (app PUBLIC cio::cio)
```

## west.yml
```
west:
  url: https://github.com/zephyrproject-rtos/west
  revision: v0.7.2

manifest:
  remotes:
    - name: gatzka
      url-base: git@github.com:gatzka
    - name: zephyr-remote
      url-base: https://github.com/zephyrproject-rtos

  projects:
    - name: cio
      remote: gatzka
      revision: master

    - name: zephyr
      remote: zephyr-remote
      revision: v2.2.0
      west-commands: scripts/west-commands.yml

    - name: net-tools
      remote: zephyr-remote
      revision: master

  self:
    path: socketecho-cio-zephyr
```

## prj.conf
```kconfig
# nothing here
CONFIG_DEBUG=y
CONFIG_DEBUG_INFO=y

CONFIG_CIO=y
CONFIG_NETWORKING=y
CONFIG_NET_SOCKETS=n
CONFIG_NET_CONFIG_NEED_IPV4=y
CONFIG_NET_CONFIG_NEED_IPV6=y
CONFIG_NET_IPV4=y
CONFIG_NET_IPV6=y
CONFIG_NET_TCP=y
CONFIG_ENTROPY_GENERATOR=y
CONFIG_DNS_RESOLVER=y

CONFIG_NET_PKT_RX_COUNT=14
CONFIG_NET_PKT_TX_COUNT=14
CONFIG_NET_BUF_RX_COUNT=28
CONFIG_NET_BUF_TX_COUNT=28
CONFIG_NET_IF_UNICAST_IPV6_ADDR_COUNT=4
CONFIG_NET_IF_MCAST_IPV6_ADDR_COUNT=5
CONFIG_NET_IF_UNICAST_IPV4_ADDR_COUNT=1
CONFIG_NET_MAX_CONTEXTS=5
CONFIG_NET_CONTEXT_SYNC_RECV=n

CONFIG_NET_CONFIG_SETTINGS=y
CONFIG_NET_CONFIG_MY_IPV6_ADDR="2001:db8:100::1"
CONFIG_NET_CONFIG_PEER_IPV6_ADDR="2001:db8:100::2"
CONFIG_NET_CONFIG_MY_IPV4_ADDR="192.0.2.1"
CONFIG_NET_CONFIG_PEER_IPV4_ADDR="192.0.2.2"
CONFIG_NET_CONFIG_MY_IPV4_NETMASK="255.255.255.0"
CONFIG_ETH_NATIVE_POSIX_RANDOM_MAC=n
CONFIG_ETH_NATIVE_POSIX_MAC_ADDR="00:00:5e:00:53:64"


CONFIG_BOARD_NATIVE_POSIX_64BIT=y
CONFIG_NET_TCP_AUTO_ACCEPT=y
```

## src/socket_echo.c
```c
/*
 * SPDX-License-Identifier: MIT
 *
 * The MIT License (MIT)
 *
 * Copyright (c) <2017> <Stephan Gatzka>
 *
 * Permission is hereby granted, free of charge, to any person obtaining
 * a copy of this software and associated documentation files (the
 * "Software"), to deal in the Software without restriction, including
 * without limitation the rights to use, copy, modify, merge, publish,
 * distribute, sublicense, and/or sell copies of the Software, and to
 * permit persons to whom the Software is furnished to do so, subject to
 * the following conditions:
 *
 * The above copyright notice and this permission notice shall be
 * included in all copies or substantial portions of the Software.
 *
 * THE SOFTWARE IS PROVIDED "AS IS", WITHOUT WARRANTY OF ANY KIND,
 * EXPRESS OR IMPLIED, INCLUDING BUT NOT LIMITED TO THE WARRANTIES OF
 * MERCHANTABILITY, FITNESS FOR A PARTICULAR PURPOSE AND
 * NONINFRINGEMENT. IN NO EVENT SHALL THE AUTHORS OR COPYRIGHT HOLDERS
 * BE LIABLE FOR ANY CLAIM, DAMAGES OR OTHER LIABILITY, WHETHER IN AN
 * ACTION OF CONTRACT, TORT OR OTHERWISE, ARISING FROM, OUT OF OR IN
 * CONNECTION WITH THE SOFTWARE OR THE USE OR OTHER DEALINGS IN THE
 * SOFTWARE.
 */

#include <signal.h>
#include <stdio.h>
#include <stdlib.h>

#include "cio_buffered_stream.h"
#include "cio_error_code.h"
#include "cio_eventloop.h"
#include "cio_inet_address.h"
#include "cio_io_stream.h"
#include "cio_read_buffer.h"
#include "cio_server_socket.h"
#include "cio_socket.h"
#include "cio_socket_address.h"
#include "cio_util.h"
#include "cio_write_buffer.h"

static struct cio_eventloop loop;
enum { SERVERSOCKET_BACKLOG = 5 };
enum { SERVERSOCKET_LISTEN_PORT = 12345 };
static const uint64_t CLOSE_TIMEOUT_NS = UINT64_C(1) * UINT64_C(1000) * UINT64_C(1000) * UINT64_C(1000);
enum { BUFFER_SIZE = 128 };
enum { IPV6_ADDRESS_SIZE = 16 };

struct echo_client {
	size_t number_of_bytes_read;
	struct cio_buffered_stream buffered_stream;
	struct cio_socket socket;
	struct cio_write_buffer wb;
	struct cio_write_buffer wbh;
	struct cio_read_buffer rb;
	uint8_t buffer[BUFFER_SIZE];
};

static struct cio_socket *alloc_echo_client(void)
{
	struct echo_client *client = malloc(sizeof(*client));
	if (cio_unlikely(client == NULL)) {
		return NULL;
	}

	cio_read_buffer_init(&client->rb, client->buffer, sizeof(client->buffer));

	return &client->socket;
}

static void free_echo_client(struct cio_socket *socket)
{
	struct echo_client *client = cio_container_of(socket, struct echo_client, socket);
	free(client);
}

static void handle_read(struct cio_io_stream *stream, void *handler_context, enum cio_error err, struct cio_read_buffer *read_buffer);

static void handle_write(struct cio_buffered_stream *bs, void *handler_context, enum cio_error err)
{
	(void)bs;
	struct echo_client *client = handler_context;

	if (err != CIO_SUCCESS) {
		fprintf(stderr, "write error!\n");
		return;
	}

	cio_read_buffer_consume(&client->rb, client->number_of_bytes_read);
	struct cio_io_stream *stream = cio_socket_get_io_stream(&client->socket);
	stream->read_some(stream, &client->rb, handle_read, client);
}

static void handle_read(struct cio_io_stream *stream, void *handler_context, enum cio_error err, struct cio_read_buffer *read_buffer)
{
	struct echo_client *client = handler_context;
	if (err == CIO_EOF) {
		fprintf(stdout, "connection close by peer\n");
		stream->close(stream);
		return;
	}

	if (err != CIO_SUCCESS) {
		fprintf(stderr, "read error!\n");
		return;
	}

	cio_write_buffer_head_init(&client->wbh);
	size_t number_of_unread_bytes = cio_read_buffer_unread_bytes(read_buffer);
	client->number_of_bytes_read = number_of_unread_bytes;
	cio_write_buffer_element_init(&client->wb, cio_read_buffer_get_read_ptr(read_buffer), number_of_unread_bytes);
	cio_write_buffer_queue_tail(&client->wbh, &client->wb);
	cio_buffered_stream_write(&client->buffered_stream, &client->wbh, handle_write, client);
}

static void handle_accept(struct cio_server_socket *ss, void *handler_context, enum cio_error err, struct cio_socket *socket)
{
	(void)handler_context;

	struct echo_client *client = cio_container_of(socket, struct echo_client, socket);

	if (err != CIO_SUCCESS) {
		fprintf(stderr, "accept error!\n");
		cio_server_socket_close(ss);
		cio_eventloop_cancel(ss->impl.loop);
		return;
	}

	struct cio_io_stream *stream = cio_socket_get_io_stream(socket);
	err = cio_buffered_stream_init(&client->buffered_stream, stream);
	if (err != CIO_SUCCESS) {
		fprintf(stderr, "could not init buffered stream!\n");
		cio_server_socket_close(ss);
		cio_eventloop_cancel(ss->impl.loop);
		return;
	}

	stream->read_some(stream, &client->rb, handle_read, client);
}

void main(void)
{
	enum cio_error err = cio_eventloop_init(&loop);
	if (err != CIO_SUCCESS) {
		fprintf(stderr, "Could not initialze eventloop!\n");
		return;
	}

	struct cio_socket_address endpoint;
	err = cio_init_inet_socket_address(&endpoint, cio_get_inet_address_any4(), SERVERSOCKET_LISTEN_PORT);
	if (err != CIO_SUCCESS) {
		fprintf(stderr, "Could not initialize socket address!\n");
		goto destroy_loop;
	}

	struct cio_server_socket ss;
	err = cio_server_socket_init(&ss, &loop, SERVERSOCKET_BACKLOG, cio_socket_address_get_family(&endpoint), alloc_echo_client, free_echo_client, CLOSE_TIMEOUT_NS, NULL);
	if (err != CIO_SUCCESS) {
		goto destroy_loop;
	}

	err = cio_server_socket_set_tcp_fast_open(&ss, true);
	if (cio_unlikely(err != CIO_SUCCESS)) {
		fprintf(stderr, "could not set TCP FASTOPEN for server socket!\n");
	}

	err = cio_server_socket_set_reuse_address(&ss, true);
	if (err != CIO_SUCCESS) {
		fprintf(stderr, "could not set reuse address for server socket!\n");
	}

	err = cio_server_socket_bind(&ss, &endpoint);
	if (err != CIO_SUCCESS) {
		fprintf(stderr, "could not bind server socket!\n");
		goto close_socket;
	}

	err = cio_server_socket_accept(&ss, handle_accept, NULL);
	if (err != CIO_SUCCESS) {
		fprintf(stderr, "could not run accept on server socket!\n");
		goto close_socket;
	}

	err = cio_eventloop_run(&loop);
	if (err != CIO_SUCCESS) {
		fprintf(stderr, "could not run event loop!\n");
	}

	fprintf(stderr, "event loop exited!\n");
close_socket:
	cio_server_socket_close(&ss);
destroy_loop:
	cio_eventloop_destroy(&loop);
	return;
}
```
